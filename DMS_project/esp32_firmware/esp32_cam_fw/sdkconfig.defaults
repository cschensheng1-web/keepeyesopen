## DMS_project/esp32_firmware/esp32_cam_fw/sdkconfig.defaults
```kconfig
# ── 芯片 - 使用PSRAM ──
CONFIG_IDF_TARGET_ESP32=y
CONFIG_ESP32_XTAL_FREQ_40=y
CONFIG_ESP32_DEFAULT_CPU_FREQ_240=y

# ── Flash 4MB ──
CONFIG_ESPTOOLPY_FLASHSIZE_4MB=y
CONFIG_ESPTOOLPY_FLASHMODE_DIO=y
CONFIG_ESPTOOLPY_FLASHFREQ_40M=y

# ── 日志 ──
CONFIG_LOG_DEFAULT_LEVEL_INFO=y

# ── PSRAM (ESP32-CAM 摄像头帧缓冲需要) ──
CONFIG_SPIRAM=y
CONFIG_SPIRAM_BOOT_INIT=y
CONFIG_SPIRAM_USE_MALLOC=y
CONFIG_SPIRAM_TYPE_AUTO=y
CONFIG_SPIRAM_SPEED_40M=y
```

## DMS_project/esp32_firmware/esp32_s3_fw/sdkconfig.defaults
```kconfig
CONFIG_IDF_TARGET_ESP32S3=y
CONFIG_ESPTOOLPY_FLASHSIZE_8MB=y
CONFIG_ESPTOOLPY_FLASHMODE_DIO=y
CONFIG_ESPTOOLPY_FLASHFREQ_80M=y
CONFIG_LOG_DEFAULT_LEVEL_INFO=y
CONFIG_PARTITION_TABLE_CUSTOM=y
CONFIG_PARTITION_TABLE_CUSTOM_FILENAME="partitions.csv"
CONFIG_PARTITION_TABLE_OFFSET=0x8000
```
